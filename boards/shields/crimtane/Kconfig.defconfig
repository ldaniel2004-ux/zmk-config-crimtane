## boards/shields/crimtane/Kconfig.defconfig
```kconfig
if SHIELD_CRIMTANE_LEFT

config ZMK_KEYBOARD_NAME
    default "Crimtane"

config ZMK_SPLIT_ROLE_CENTRAL
    default y

endif # SHIELD_CRIMTANE_LEFT

if SHIELD_CRIMTANE_LEFT || SHIELD_CRIMTANE_RIGHT

config ZMK_SPLIT
    default y

endif # SHIELD_CRIMTANE_LEFT || SHIELD_CRIMTANE_RIGHT
```

## boards/shields/crimtane/Kconfig.shield
```kconfig
config SHIELD_CRIMTANE_LEFT
    def_bool $(shields_list_contains,crimtane_left)

config SHIELD_CRIMTANE_RIGHT
    def_bool $(shields_list_contains,crimtane_right)
```
