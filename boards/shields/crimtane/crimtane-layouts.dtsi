#include <physical_layouts.dtsi>

/ {
    // =========================================================================
    // 1. MAIN SPLIT KEYBOARD LAYOUT
    // =========================================================================
    crimtane_layout: crimtane_layout {
        compatible = "zmk,physical-layout";
        display-name = "Crimtane Split Keyboard";
	transform = <&default_transform>;
    };

};
