#include "crimtane.dtsi"

&default_transform { 
    col-offset = <7>;
};

/ {
    chosen {
        zmk,kscan = &kscan;
        zmk,physical-layout = &crimtane_layout; // explicitly locks right side to split map
    };
};

&kscan {
    col-gpios
        = <&pro_micro 3 GPIO_ACTIVE_HIGH>
        , <&pro_micro 4 GPIO_ACTIVE_HIGH>
        , <&pro_micro 5 GPIO_ACTIVE_HIGH>
        , <&pro_micro 6 GPIO_ACTIVE_HIGH>
        , <&pro_micro 7 GPIO_ACTIVE_HIGH>
        , <&pro_micro 8 GPIO_ACTIVE_HIGH>
	, <&pro_micro 9 GPIO_ACTIVE_HIGH>
        ;
};